## wic/erica-x86-usbimage.wks
```
# Copyright © Advanced Micro Devices, Inc., or its affiliates. All rights reserved.
# SPDX-License-Identifier: MIT
# Contributors: KC
# Maintainer: KC

part /boot --source bootimg-partition --ondisk sda --fstype=vfat --label boot --overhead-factor 1.3 --active --align 1024
part / --source rootfs --ondisk sda --fstype=ext4 --label root --align 1024 --overhead-factor 1.2
```
